## boards/arm/akdk_rp2040/Kconfig.board
```kconfig
# Copyright (c) 2024 The ZMK Contributors
# SPDX-License-Identifier: Apache-2.0

config BOARD_AKDK_RP2040
    bool "Auto KDK RP2040"
    depends on SOC_RP2040
```

## boards/arm/akdk_rp2040/Kconfig.defconfig
```kconfig
# Copyright (c) 2024 The ZMK Contributors
# SPDX-License-Identifier: Apache-2.0

if BOARD_AKDK_RP2040

config BOARD
    default "akdk_rp2040"

config RP2_FLASH_W25Q080
    default y

endif # BOARD_AKDK_RP2040
```

## config/boards/arm/akdk-nrf52840/Kconfig.board
```kconfig
# SPDX-License-Identifier: MIT

config BOARD_AKDK_NRF52840
	bool "akdk_nrf52840"
	depends on SOC_NRF52840_QIAA
```

## config/boards/arm/akdk-nrf52840/Kconfig.defconfig
```kconfig
if BOARD_AKDK_NRF52840

if USB_DEVICE_STACK

config USB_NRFX
    default y

endif # USB_DEVICE_STACK

config BT_CTLR
    default BT

endif
```
